## CMakeLists.txt
```
#
# Copyright (c) 2018 Nordic Semiconductor
#
# SPDX-License-Identifier: LicenseRef-BSD-5-Clause-Nordic
#

cmake_minimum_required(VERSION 3.13.1)

#include(../../../cmake/boilerplate.cmake)
find_package(Zephyr REQUIRED HINTS C:/Users/Marco/Desktop/NORDICDOC/SDK/zephyr)
project(mqtt-simple3)

# NORDIC SDK APP START
target_sources(app PRIVATE src/main.c)
# NORDIC SDK APP END
```

## Kconfig
```
#
# Copyright (c) 2018 Nordic Semiconductor ASA
#
# SPDX-License-Identifier: LicenseRef-BSD-5-Clause-Nordic
#

menu "MQTT simple sample"

config PROVISION_CERTIFICATES
	bool "Provision of certificate"
	help
		Enable run-time provisioning of certificates from the
		certificates header file selected by using CERTIFICATES_FILE

config CERTIFICATES_FILE
	string "Certificates to use"
	depends on PROVISION_CERTIFICATES
	default "certificates.h"

config SEC_TAG
	int "Security tag to use for the connection"
	default 78
	
config PEER_VERIFY
    int "Peer verify parameter for mqtt_client"
    default 1
    help
        Set to 0 for VERIFY_NONE, 1 for VERIFY_OPTIONAL, and 2 for VERIFY_REQUIRED.

config MQTT_PUB_TOPIC
	string "MQTT publish topic"
	default "@online/5d0f6457-8ab4-4ee2-9363-438f2de5b278"
	
config BEDROOM_TOPIC
	string "MQTT publish topic"
	default "@online/5d0f6457-8ab4-4ee2-9363-438f2de5b278/Bedroom/TempController/TempMeasurement/BedroomTemp"
	
config KITCHEN_TOPIC
	string "MQTT publish topic"
	default "@online/5d0f6457-8ab4-4ee2-9363-438f2de5b278/Kitchen/TempMeasurement/KitchenTemp"

config MQTT_SUB_TOPIC
	string "MQTT subscribe topic"
	default "@set/5d0f6457-8ab4-4ee2-9363-438f2de5b278/#"

config MQTT_CLIENT_ID
	string "MQTT Client ID"
	default "my-client-id"

config MQTT_BROKER_HOSTNAME
	string "MQTT broker hostname"
	default "153.109.15.40"

config MQTT_BROKER_PORT
	int "MQTT broker port"
	default 8883

config MQTT_MESSAGE_BUFFER_SIZE
	int ""
	default 2048

config MQTT_PAYLOAD_BUFFER_SIZE
	int ""
	default 2048

endmenu

menu "Zephyr Kernel"
source "$ZEPHYR_BASE/Kconfig.zephyr"
endmenu
```

## prj.conf
```kconfig
#
# Copyright (c) 2019 Nordic Semiconductor ASA
#
# SPDX-License-Identifier: LicenseRef-BSD-5-Clause-Nordic
#

# Networking
CONFIG_NETWORKING=y
CONFIG_NET_NATIVE=n
CONFIG_NET_SOCKETS_OFFLOAD=y
CONFIG_NET_SOCKETS=y
CONFIG_NET_SOCKETS_POSIX_NAMES=y

# LTE link control
CONFIG_LTE_LINK_CONTROL=y
CONFIG_LTE_AUTO_INIT_AND_CONNECT=n

# BSD library
CONFIG_BSD_LIBRARY=y

# Certificates provision
CONFIG_MODEM_KEY_MGMT=y

# AT Host
CONFIG_UART_INTERRUPT_DRIVEN=y
CONFIG_AT_HOST_LIBRARY=y

# MQTT
CONFIG_MQTT_LIB=y
CONFIG_MQTT_LIB_TLS=y

# Application
CONFIG_MQTT_PUB_TOPIC="@online/5d0f6457-8ab4-4ee2-9363-438f2de5b278"
CONFIG_MQTT_SUB_TOPIC="@set/5d0f6457-8ab4-4ee2-9363-438f2de5b278/#"
CONFIG_MQTT_CLIENT_ID="nrf2"
CONFIG_MQTT_BROKER_HOSTNAME="153.109.15.40"
CONFIG_MQTT_BROKER_PORT=8883
CONFIG_SEC_TAG=78
CONFIG_PEER_VERIFY=1

CONFIG_PROVISION_CERTIFICATES=y

CONFIG_CERTIFICATES_FILE="certificatesNRF.h"

# Main thread
CONFIG_MAIN_STACK_SIZE=16384

CONFIG_HEAP_MEM_POOL_SIZE=8192
```

## src/main.c
```c
/*
 * Copyright (c) 2018 Nordic Semiconductor ASA
 *
 * SPDX-License-Identifier: LicenseRef-BSD-5-Clause-Nordic
 */

#include <zephyr.h>
#include <stdio.h>
#include <string.h>

#include <net/mqtt.h>
#include <net/socket.h>
#include <modem_key_mgmt.h>
#include <lte_lc.h>

#if defined(CONFIG_PROVISION_CERTIFICATES)
#include CONFIG_CERTIFICATES_FILE
#endif

#if defined(CONFIG_MQTT_LIB_TLS)
	static sec_tag_t sec_tag_list[] = { CONFIG_SEC_TAG };
#endif

/* Buffers for MQTT client. */
static u8_t rx_buffer[CONFIG_MQTT_MESSAGE_BUFFER_SIZE];
static u8_t tx_buffer[CONFIG_MQTT_MESSAGE_BUFFER_SIZE];
static u8_t payload_buf[CONFIG_MQTT_PAYLOAD_BUFFER_SIZE];

/* The mqtt client struct */
static struct mqtt_client client;
static struct mqtt_topic lastWill;

/* MQTT Broker details. */
static struct sockaddr_storage broker;

/* Connected flag */
static bool connected;

/* File descriptor */
struct pollfd fds;

/* Attribute value */
int setPoint=20;
double kitchenValue=10.0;
double bedroomValue=10.0;
long long timestamp=1601108328;

/* Timer */
static struct k_timer timer_poll;       //Timer for poll
static struct k_timer timer_delay;      //Timer to wait if server busy (mqtt_live error :11)
//static bool busy;

/*Topic of willTopic*/
static char willTopic[46]="@offline/5d0f6457-8ab4-4ee2-9363-438f2de5b278";

/**@brief Function to print strings without null-termination
 */
static void data_print(u8_t *prefix, u8_t *data, size_t len)
{
	char buf[len + 1];

	memcpy(buf, data, len);
	buf[len] = 0;
	printk("%s%s\n", prefix, buf);
}

/**@brief Function to publish data on the configured topic
 */
static int data_publish(struct mqtt_client *c, enum mqtt_qos qos,
	u8_t *data, size_t len)
{
	struct mqtt_publish_param param;

	param.message.topic.qos = qos;
	param.message.topic.topic.utf8 = CONFIG_MQTT_PUB_TOPIC;
	param.message.topic.topic.size = strlen(CONFIG_MQTT_PUB_TOPIC);
	param.message.payload.data = data;
	param.message.payload.len = len;
	param.message_id = sys_rand32_get();
	param.dup_flag = 0;
	param.retain_flag = 0;

	data_print("Publish: ", data, len);
	printk("to topic: %s len: %u\n",
		CONFIG_MQTT_PUB_TOPIC,
		(unsigned int)strlen(CONFIG_MQTT_PUB_TOPIC));

	return mqtt_publish(c, &param);
}

/**@brief Function to publish birth message to the Endpoint
  */
static void sendBirthMessage(){
        char json[] = ENDPOINT_JSON;
        char *p = &json[0];
        size_t count =0;
        while(*p!='\0'){
          payload_buf[count]=json[count];
          p++;
          count++;
        }
        //k_timer_start(&timer_poll, K_SECONDS(5),0);
        data_publish(&client, MQTT_QOS_1_AT_LEAST_ONCE,
                payload_buf, count);
}

/**@brief Function to subscribe to the configured topic
 */
static int subscribe(void)
{
	struct mqtt_topic subscribe_topic = {
		.topic = {
			.utf8 = CONFIG_MQTT_SUB_TOPIC,
			.size = strlen(CONFIG_MQTT_SUB_TOPIC)
		},
		.qos = MQTT_QOS_1_AT_LEAST_ONCE
	};

	const struct mqtt_subscription_list subscription_list = {
		.list = &subscribe_topic,
		.list_count = 1,
		.message_id = 1234
	};

	printk("Subscribing to: %s len %u\n", CONFIG_MQTT_SUB_TOPIC,
		(unsigned int)strlen(CONFIG_MQTT_SUB_TOPIC));
        sendBirthMessage();

	return mqtt_subscribe(&client, &subscription_list);
}

/**@brief Function to read the published payload.
 */
static int publish_get_payload(struct mqtt_client *c, size_t length)
{
	u8_t *buf = payload_buf;
	u8_t *end = buf + length;

	if (length > sizeof(payload_buf)) {
		return -EMSGSIZE;
	}

	while (buf < end) {
		int ret = mqtt_read_publish_payload(c, buf, end - buf);

		if (ret < 0) {
			if (ret == -EAGAIN) {
				printk("mqtt_read_publish_payload: EAGAIN");
				poll(&fds, 1, K_FOREVER);
				continue;
			}

			return ret;
		}

		if (ret == 0) {
			return -EIO;
		}

		buf += ret;
	}

	return 0;
}

/**@brief MQTT client event handler
 */
void mqtt_evt_handler(struct mqtt_client *const c,
		      const struct mqtt_evt *evt)
{
	int err;

	switch (evt->type) {
	case MQTT_EVT_CONNACK:
		if (evt->result != 0) {
			printk("MQTT connect failed %d\n", evt->result);
			break;
		}

		connected = true;
		printk("[%s:%d] MQTT client connected!\n", __func__, __LINE__);
                subscribe();
		break;

	case MQTT_EVT_DISCONNECT:
		printk("[%s:%d] MQTT client disconnected %d\n", __func__,
		       __LINE__, evt->result);

		connected = false;
		break;

	case MQTT_EVT_PUBLISH: {
		const struct mqtt_publish_param *p = &evt->param.publish;

		printk("[%s:%d] MQTT PUBLISH result=%d len=%d\n", __func__,
		       __LINE__, evt->result, p->message.payload.len);
		err = publish_get_payload(c, p->message.payload.len);
		if (err >= 0) {
			data_print("Received: ", payload_buf,
				p->message.payload.len);
			/* Echo back received data */
			//data_publish(&client, MQTT_QOS_1_AT_LEAST_ONCE,
				//payload_buf, p->message.payload.len);
		} else {
			printk("mqtt_read_publish_payload: Failed! %d\n", err);
		}
	} break;

	case MQTT_EVT_PUBACK:
		if (evt->result != 0) {
			printk("MQTT PUBACK error %d\n", evt->result);
			break;
		}

		printk("[%s:%d] PUBACK packet id: %u\n", __func__, __LINE__,
				evt->param.puback.message_id);
		break;

	case MQTT_EVT_SUBACK:
		if (evt->result != 0) {
			printk("MQTT SUBACK error %d\n", evt->result);
			break;
		}

		printk("[%s:%d] SUBACK packet id: %u\n", __func__, __LINE__,
				evt->param.suback.message_id);
		break;

	default:
		printk("[%s:%d] default: %d\n", __func__, __LINE__,
				evt->type);
		break;
	}
}

/**@brief Resolves the configured hostname and
 * initializes the MQTT broker structure
 */
static void broker_init(void)
{
	int err;
	struct addrinfo *result;
	struct addrinfo *addr;
	struct addrinfo hints;

	hints.ai_flags = 0;
	hints.ai_family = AF_INET;
	hints.ai_socktype = SOCK_STREAM;
	hints.ai_protocol = 0;

	err = getaddrinfo(CONFIG_MQTT_BROKER_HOSTNAME, NULL, &hints, &result);
	if (err) {
		printk("ERROR: getaddrinfo failed %d\n", err);

		return;
	}

	addr = result;
	err = -ENOENT;

	/* Look for address of the broker. */
	while (addr != NULL) {
		/* IPv4 Address. */
		if (addr->ai_addrlen == sizeof(struct sockaddr_in)) {
			struct sockaddr_in *broker4 =
				((struct sockaddr_in *)&broker);

			broker4->sin_addr.s_addr =
				((struct sockaddr_in *)addr->ai_addr)
				->sin_addr.s_addr;
			broker4->sin_family = AF_INET;
			broker4->sin_port = htons(CONFIG_MQTT_BROKER_PORT);
			printk("IPv4 Address found 0x%08x\n",
				broker4->sin_addr.s_addr);
			break;
		} else {
			printk("ai_addrlen = %u should be %u or %u\n",
				(unsigned int)addr->ai_addrlen,
				(unsigned int)sizeof(struct sockaddr_in),
				(unsigned int)sizeof(struct sockaddr_in6));
		}

		addr = addr->ai_next;
		break;
	}

	/* Free the address. */
	freeaddrinfo(result);
}

/**@brief Initialize the MQTT client structure
 */
static void client_init(struct mqtt_client *client)
{
	mqtt_client_init(client);

	broker_init();

	/* MQTT client configuration */
	client->broker = &broker;
	client->evt_cb = mqtt_evt_handler;
	client->client_id.utf8 = (u8_t *)CONFIG_MQTT_CLIENT_ID;
	client->client_id.size = strlen(CONFIG_MQTT_CLIENT_ID);
	client->password = NULL;
	client->user_name = NULL;
	client->protocol_version = MQTT_VERSION_3_1_1;

        /* Will topic */
        lastWill.topic.utf8=&willTopic;
        lastWill.topic.size=45;
        client->will_topic=&lastWill;

	/* MQTT buffers configuration */
	client->rx_buf = rx_buffer;
	client->rx_buf_size = sizeof(rx_buffer);
	client->tx_buf = tx_buffer;
	client->tx_buf_size = sizeof(tx_buffer);

	/* MQTT transport configuration */
#if defined(CONFIG_MQTT_LIB_TLS)
	struct mqtt_sec_config *tls_config = &client->transport.tls.config;
	
	client->transport.type = MQTT_TRANSPORT_SECURE;

	tls_config->peer_verify = CONFIG_PEER_VERIFY;
	tls_config->cipher_count = 0;
	tls_config->cipher_list = NULL;
	tls_config->sec_tag_count = ARRAY_SIZE(sec_tag_list);
	tls_config->sec_tag_list = sec_tag_list;
	tls_config->hostname = CONFIG_MQTT_BROKER_HOSTNAME;
        tls_config->hostname = "rabbit";
#else
	client->transport.type = MQTT_TRANSPORT_NON_SECURE;
#endif
}

/**@brief Initialize the file descriptor structure used by poll.
 */
static int fds_init(struct mqtt_client *c)
{
	if (c->transport.type == MQTT_TRANSPORT_NON_SECURE) {
		fds.fd = c->transport.tcp.sock;
	} else {
#if defined(CONFIG_MQTT_LIB_TLS)
		fds.fd = c->transport.tls.sock;
#else
		return -ENOTSUP;
#endif
	}

	fds.events = POLLIN;

	return 0;
}

/**@brief Configures modem to provide LTE link. Blocks until link is
 * successfully established.
 */
static void modem_configure(void)
{
#if defined(CONFIG_LTE_LINK_CONTROL)
	if (IS_ENABLED(CONFIG_LTE_AUTO_INIT_AND_CONNECT)) {
		/* Do nothing, modem is already turned on
		 * and connected.
		 */
	} else {
		int err;

		printk("LTE Link Connecting ...\n");
		err = lte_lc_init_and_connect();
		__ASSERT(err == 0, "LTE link could not be established.");
		printk("LTE Link Connected!\n");
	}
#endif
}

static int provision_certificate(void)
{
#if defined(CONFIG_PROVISION_CERTIFICATES)
#if defined(CONFIG_BSD_LIBRARY)
	{
		int err;

		/* Delete certificates */
		nrf_sec_tag_t sec_tag = (nrf_sec_tag_t) sec_tag_list[0];

		for (enum modem_key_mgnt_cred_type type = 0; type < 5; type++) {
			printk("Deleting certs sec_tag: %d\n", sec_tag);
			err = modem_key_mgmt_delete(sec_tag, type);
			printk("nrf_inbuilt_key_delete(%u, %d) => result=%d\n",
				sec_tag, type, err);
		}

#if defined(CA_CERTIFICATE)
		/* Provision CA Certificate. */
		printk("Write ca certs sec_tag: %d\n", sec_tag);
                err = modem_key_mgmt_write(sec_tag,
				   MODEM_KEY_MGMT_CRED_TYPE_CA_CHAIN,
				   CA_CERTIFICATE, strlen(CA_CERTIFICATE));
		if (err) {
			printk("CA_CERTIFICATE err: %d\n", err);
			return err;
		}
#endif
#if defined (CLIENT_PRIVATE_KEY)
		/* Provision Private Certificate. */
		printk("Write private cert sec_tag: %d\n", sec_tag);
		err = modem_key_mgmt_write(
			sec_tag,
			MODEM_KEY_MGMT_CRED_TYPE_PRIVATE_CERT,
			CLIENT_PRIVATE_KEY,
			strlen(CLIENT_PRIVATE_KEY));
		if (err) {
			printk("CLIENT_PRIVATE_KEY err: %d\n", err);
			return err;
		}
#endif
#if defined(CLIENT_PUBLIC_CERTIFICATE)
		/* Provision Public Certificate. */
		printk("Write public cert sec_tag: %d\n", sec_tag);
		err = modem_key_mgmt_write(
			sec_tag,
			MODEM_KEY_MGMT_CRED_TYPE_PUBLIC_CERT,
			CLIENT_PUBLIC_CERTIFICATE,
			strlen(CLIENT_PUBLIC_CERTIFICATE));
		if (err) {
			printk("CLIENT_PUBLIC_CERTIFICATE err: %d\n",
				err);
			return err;
		}
	}
#endif
#else
	{
		int err;

		err = tls_credential_add(CONFIG_SEC_TAG,
			TLS_CREDENTIAL_CA_CERTIFICATE,
			NRF_CLOUD_CA_CERTIFICATE,
			sizeof(NRF_CLOUD_CA_CERTIFICATE));
		if (err < 0) {
			printk("Failed to register ca certificate: %d\n",
				err);
			return err;
		}
		err = tls_credential_add(CONFIG_SEC_TAG,
			TLS_CREDENTIAL_PRIVATE_KEY,
			NRF_CLOUD_CLIENT_PRIVATE_KEY,
			sizeof(NRF_CLOUD_CLIENT_PRIVATE_KEY));
		if (err < 0) {
			printk("Failed to register private key: %d\n",
				err);
			return err;
		}
		err = tls_credential_add(CONFIG_SEC_TAG,
			TLS_CREDENTIAL_SERVER_CERTIFICATE,
			NRF_CLOUD_CLIENT_PUBLIC_CERTIFICATE,
			sizeof(NRF_CLOUD_CLIENT_PUBLIC_CERTIFICATE));
		if (err < 0) {
			printk("Failed to register public certificate: %d\n",
				err);
			return err;
		}

	}
#endif /* defined(CONFIG_BSD_LIBRARY) */
#endif /* defined(CONFIG_PROVISION_CERTIFICATES) */

	return 0;
}

void sendMessage(struct k_timer *timer_id){
    //MAKE A JSON FILE

    //SEND

    //RESTART TIME
    k_timer_start(&timer_poll, K_SECONDS(5),0);
}

void delay_function(struct k_timer *timer_id){
          int err;
        
          err = mqtt_input(&client);
          if (err != 0) {
                  printk("ERROR: mqtt_input %d\n", err);
          }

          err = mqtt_live(&client);
          if (err != 0) {
                  printk("ERROR: mqtt_live %d\n", err);
          }

          if (poll(&fds, 1, K_SECONDS(CONFIG_MQTT_KEEPALIVE)) < 0) {
                  printk("ERROR: poll %d\n", errno);
          }
          k_timer_start(&timer_delay, K_SECONDS(20), 0);
}

void main(void)
{
	int err;

        k_timer_init(&timer_poll, sendMessage, NULL);
        k_timer_init(&timer_delay, delay_function, NULL);

	printk("The MQTT simple sample started\n");

	//provision_certificate();

	modem_configure();
        //printk(ENDPOINT_JSON);

	client_init(&client);
	err = mqtt_connect(&client);
	if (err != 0) {
		printk("ERROR: mqtt_connect %d\n", err);
		return;
	}

	err = fds_init(&client);
	if (err != 0) {
		printk("ERROR: fds_init %d\n", err);
		return;
	}
        //Delay the keep alive a little.
        k_timer_start(&timer_delay, K_SECONDS(3), 0);

        while(1){

        }
}
```

## src/certificatesMosquito.h
```c
//<certificates.h>

#ifndef _CERTIFICATES_H_
#define _CERTIFICATES_H_

#define CA_CERTIFICATE \
    "-----BEGIN CERTIFICATE-----\n" \
	"MIIEAzCCAuugAwIBAgIUBY1hlCGvdj4NhBXkZ/uLUZNILAwwDQYJKoZIhvcNAQEL\n" \
	"BQAwgZAxCzAJBgNVBAYTAkdCMRcwFQYDVQQIDA5Vbml0ZWQgS2luZ2RvbTEOMAwG\n" \
	"A1UEBwwFRGVyYnkxEjAQBgNVBAoMCU1vc3F1aXR0bzELMAkGA1UECwwCQ0ExFjAU\n" \
	"BgNVBAMMDW1vc3F1aXR0by5vcmcxHzAdBgkqhkiG9w0BCQEWEHJvZ2VyQGF0Y2hv\n" \
	"by5vcmcwHhcNMjAwNjA5MTEwNjM5WhcNMzAwNjA3MTEwNjM5WjCBkDELMAkGA1UE\n" \
	"BhMCR0IxFzAVBgNVBAgMDlVuaXRlZCBLaW5nZG9tMQ4wDAYDVQQHDAVEZXJieTES\n" \
	"MBAGA1UECgwJTW9zcXVpdHRvMQswCQYDVQQLDAJDQTEWMBQGA1UEAwwNbW9zcXVp\n" \
	"dHRvLm9yZzEfMB0GCSqGSIb3DQEJARYQcm9nZXJAYXRjaG9vLm9yZzCCASIwDQYJ\n" \
	"KoZIhvcNAQEBBQADggEPADCCAQoCggEBAME0HKmIzfTOwkKLT3THHe+ObdizamPg\n" \
	"UZmD64Tf3zJdNeYGYn4CEXbyP6fy3tWc8S2boW6dzrH8SdFf9uo320GJA9B7U1FW\n" \
	"Te3xda/Lm3JFfaHjkWw7jBwcauQZjpGINHapHRlpiCZsquAthOgxW9SgDgYlGzEA\n" \
	"s06pkEFiMw+qDfLo/sxFKB6vQlFekMeCymjLCbNwPJyqyhFmPWwio/PDMruBTzPH\n" \
	"3cioBnrJWKXc3OjXdLGFJOfj7pP0j/dr2LH72eSvv3PQQFl90CZPFhrCUcRHSSxo\n" \
	"E6yjGOdnz7f6PveLIB574kQORwt8ePn0yidrTC1ictikED3nHYhMUOUCAwEAAaNT\n" \
	"MFEwHQYDVR0OBBYEFPVV6xBUFPiGKDyo5V3+Hbh4N9YSMB8GA1UdIwQYMBaAFPVV\n" \
	"6xBUFPiGKDyo5V3+Hbh4N9YSMA8GA1UdEwEB/wQFMAMBAf8wDQYJKoZIhvcNAQEL\n" \
	"BQADggEBAGa9kS21N70ThM6/Hj9D7mbVxKLBjVWe2TPsGfbl3rEDfZ+OKRZ2j6AC\n" \
	"6r7jb4TZO3dzF2p6dgbrlU71Y/4K0TdzIjRj3cQ3KSm41JvUQ0hZ/c04iGDg/xWf\n" \
	"+pp58nfPAYwuerruPNWmlStWAXf0UTqRtg4hQDWBuUFDJTuWuuBvEXudz74eh/wK\n" \
	"sMwfu1HFvjy5Z0iMDU8PUDepjVolOCue9ashlS4EB5IECdSR2TItnAIiIwimx839\n" \
	"LdUdRudafMu5T5Xma182OC0/u/xRlEm+tvKGGmfFcN0piqVl8OrSPBgIlb+1IKJE\n" \
	"m/XriWr/Cq4h/JfB7NTsezVslgkBaoU=\n" \
	"-----END CERTIFICATE-----\n" \

#define CLIENT_PRIVATE_KEY \
    "-----BEGIN RSA PRIVATE KEY-----\n" \
	"MIIEowIBAAKCAQEA9ZAnpOwoCCFhcfGeA42YsjiYeQGj4AWWs77NMbNNgqtmlHKJ\n" \
	"nW/yT/e8peaA+0RrmJZ0oOEstsZm0X/PiJ62iYq3ZJh7DSQnYhXAl/r7yC0BEClu\n" \
	"qn6OKcZfB3nGwT5tgPK32OZYFTghwUfQFHx7PMEz98/sZR1gh1NUgvsr80IRBKg/\n" \
	"KU7NvxrxQ/pjI9tQPYtFo6CK4kobITS5uEmbeobsldYwGLdDIK3J3tP8V2hkcxrP\n" \
	"J2LSeugdPRmyel8cOPgqQvASDJuiKru91NZXYj/IxYdFlEC9Y4srJXb/ZQ42Sd0E\n" \
	"RrB0mByCpIcJpTlSwTudSAU7UVLCfJuw0e0mtwIDAQABAoIBAGUq1qpjgLqYxgSj\n" \
	"fm4IT/hcyLRRsKoCo2u6F99591z2MHTIG1n5XOMFNXtD06+xKILcuX/uRPWoF4QI\n" \
	"HAA1Iw7XT2bqSwfG9VK7k3UJueFmaSG3cBhdu0QKrevuh6vlhEezt3psq61SStXO\n" \
	"ODO4dS06i6Z0yvd9et9FvXOY9ypoJvCPFZ3b/uxkZwUnF6NtuuEsCzgob94/m0fX\n" \
	"JDUJ79xcepffe9OFfVdrhqlpSzFgxNDtyEAGJ+jsEZCWGVP0IqPV900n2x1tRVim\n" \
	"K+jSZ4OwIvAQpvup2/R40DNjFpuLq/dvKwhUgSESuY8GJ4I3s48r3zwCcu777tCc\n" \
	"sK7Sy0ECgYEA/SAofz6jXORlyC3fjCEIsSipPYny+sz+lnaSTVK9iWXltIJf3YIC\n" \
	"vsha8nj08c1FpnnZrNKi5kA6jXgPaXRq//xyxV1zbs7vDPAPnjWOcR2dfyv2V9lx\n" \
	"whYAOdFnxisWd26ou0CB3uVipeLwntX4+zsBJ4xal/a+/1ieN5lJ/20CgYEA+FoD\n" \
	"JHMJOWcnXGxdxYqL8Yr+lg4dJAG67hsZjF3T7oWvCLQFWBjuJ/ycSL/oZzSJidjq\n" \
	"ukh6EFfrSAupVBQCnICN74YmKfrE57Mq55PEce3wRrcwroETyGwQ2k4wDGkzrFGn\n" \
	"tVho5qew4wkK8IhpxzBelJscMsatRPSzgXSt1DMCgYAIw31Dcoq7Y5j2hkgQFPC1\n" \
	"GYBKhiUoc8J4uSA1lyDCygla54ykIaUwr8UeUfvBB2da7SsRJbXIHP8p+Lcn4oT1\n" \
	"2eqrVKHzeyyhmQohYx9MYUcbqQz9W6TpoFNfrRVXshQ0DFvBJ+mXKv/wWFwWU7gs\n" \
	"Eo3mraBRVJSmSI4pxJ/gPQKBgAtWkK4pUlJ8kx91ExLhsGHmppjTLCFostAMDK6L\n" \
	"2hEZqVQMY/IRsU3CCqCHomST0XOpo429oVT9rpAreB+Oik/6zoAQ780a1cJ+O4c3\n" \
	"B9Dru/x+gIp2+iA8TsioqSjn5KQJVk7BKojdPwYec5FnqOyfGLJQIolu6JotUcSn\n" \
	"PwhhAoGBAKNHn7aoFvk6dJm2aEOG1Xf5+h5VULIqnJQef/UOcFQYraiXyjAW965I\n" \
	"TLoWECDVEabCkHVIg8NKXIewkx62vhkVoZhyb4mBYFTneCixGNkw5tv0dRzCfTOS\n" \
	"l2mGIY4LX0LMfZAd3+/pL6yTGREthbOAebQUI9nspV9LmEzYlots\n" \
	"-----END RSA PRIVATE KEY-----\n" \

#define CLIENT_PUBLIC_CERTIFICATE \
    "-----BEGIN CERTIFICATE-----\n" \
	"MIIDTzCCAjegAwIBAgIBADANBgkqhkiG9w0BAQsFADCBkDELMAkGA1UEBhMCR0Ix\n" \
	"FzAVBgNVBAgMDlVuaXRlZCBLaW5nZG9tMQ4wDAYDVQQHDAVEZXJieTESMBAGA1UE\n" \
	"CgwJTW9zcXVpdHRvMQswCQYDVQQLDAJDQTEWMBQGA1UEAwwNbW9zcXVpdHRvLm9y\n" \
	"ZzEfMB0GCSqGSIb3DQEJARYQcm9nZXJAYXRjaG9vLm9yZzAeFw0yMDA4MjAxMzM4\n" \
	"MzdaFw0yMDExMTgxMzM4MzdaMCkxCzAJBgNVBAYTAkNIMQwwCgYDVQQKDANIRVMx\n" \
	"DDAKBgNVBAMMA05SRjCCASIwDQYJKoZIhvcNAQEBBQADggEPADCCAQoCggEBAPWQ\n" \
	"J6TsKAghYXHxngONmLI4mHkBo+AFlrO+zTGzTYKrZpRyiZ1v8k/3vKXmgPtEa5iW\n" \
	"dKDhLLbGZtF/z4ietomKt2SYew0kJ2IVwJf6+8gtARApbqp+jinGXwd5xsE+bYDy\n" \
	"t9jmWBU4IcFH0BR8ezzBM/fP7GUdYIdTVIL7K/NCEQSoPylOzb8a8UP6YyPbUD2L\n" \
	"RaOgiuJKGyE0ubhJm3qG7JXWMBi3QyCtyd7T/FdoZHMazydi0nroHT0ZsnpfHDj4\n" \
	"KkLwEgyboiq7vdTWV2I/yMWHRZRAvWOLKyV2/2UONkndBEawdJgcgqSHCaU5UsE7\n" \
	"nUgFO1FSwnybsNHtJrcCAwEAAaMaMBgwCQYDVR0TBAIwADALBgNVHQ8EBAMCBeAw\n" \
	"DQYJKoZIhvcNAQELBQADggEBAJJJKAp/R54jhcRXz77NkJ3cFi5tJrwrj5NRneVj\n" \
	"ums/FKhmgpFOHW09nuQtdwPVbTjd9RkrWc9YqGWrfnReApoDFk/X5RZY5K2AEfr6\n" \
	"isHzttm72EzLG7l1iwVL+llmQQBYXMTbaLlp+7Kix1yR9bgkVyE00GcMG3b8k8av\n" \
	"6CcdYjIXS49ZQIlSPZa8ow7cIXCGb1jALF755q/IrbUoJuHGvzLtJjANATMEj/gr\n" \
	"HozBfw8O9ukHhPAl2I2GHn/2wdyqiMq78il48kEjV1kqq8VNGObriHrNJ79CMW1n\n" \
	"q35CGzexNRu3XhjvR1WxU5u5TR315ysnl/mp52zI+UtMj4U=\n" \
	"-----END CERTIFICATE-----\n" \

#endif /* _CERTIFICATES_H_ */
```

## src/certificatesNRF.h
```c
//<certificates.h>

#ifndef _CERTIFICATES_H_
#define _CERTIFICATES_H_

#define CA_CERTIFICATE \
    "-----BEGIN CERTIFICATE-----\n" \
	"MIIC3TCCAcWgAwIBAgIUe7w7MLPWzczgbLghvEcpDY4nhDkwDQYJKoZIhvcNAQEL\n" \
	"BQAwGTEXMBUGA1UEAwwOY2xvdWRpby1kZXYtY2EwHhcNMjAwODMxMDYzNzQ0WhcN\n" \
	"MzAwODI5MDYzNzQ0WjAZMRcwFQYDVQQDDA5jbG91ZGlvLWRldi1jYTCCASIwDQYJ\n" \
	"KoZIhvcNAQEBBQADggEPADCCAQoCggEBALDq/+inzFOOiXAsgcv9Rs6jnvalBpzy\n" \
	"FCs8uUeovWWjLzyoa4aMd1c3wlrc/l3FjTPOqkt8AEUDaHYnzi1P5MysuuywoY/G\n" \
	"qhlZ/InD0ehuI3H58RvFHruRsseBrqswjNbDmJfArMufGNAoVS8PTe990yPKCUMO\n" \
	"u0B5x2QfpCSrKIdEWyDEW1ehKSqfQRCX68dUFQ6+Lne50CHHqvnwsF3DQSmlN3GN\n" \
	"UhFa5vIbqWdu5ZVeSWifsCLt+rMetCGe/Ib4CQpGNg/6O7ERQLigg0/gnmjkhQnM\n" \
	"9e+FI3Zb7+36MCl66W3bcU3mz7AC9UZLGJGcYTCvwPkjan3F4k0PTR0CAwEAAaMd\n" \
	"MBswDAYDVR0TBAUwAwEB/zALBgNVHQ8EBAMCAQYwDQYJKoZIhvcNAQELBQADggEB\n" \
	"AAFrrV2gigOvQUL9VKwdqgtnPqF4iiYKl6LUu2ze3u07CIWe+6MPUb9a2QOoPaWP\n" \
	"ryqoaKdA/tENtMIdgIh9pGI3nkRNBB8HhT29J+ZzkDDm2TvfICoiDo79ZlYDeSXe\n" \
	"9mRJmdMyIT9eAuzB1B8qNrrVRG4ADfkKcwbwof8VMWjntTddM1+pGyzDgZ1MHlbs\n" \
	"dmM59o1MGLxEn1S13kqMA0twKNQOB6r9JP/CVfHVnzxahShf8hzFtIEp7M9ocy44\n" \
	"LWRFrQiR038OnOrkKdKwGxPjtbiQG7yFd1fMFGoy86DymMX1BdRXp8tgJNGWMfsf\n" \
	"syza6DtiT7AAK6gBCLhDGrg=\n" \
	"-----END CERTIFICATE-----\n" \

#define CLIENT_PRIVATE_KEY \
    "-----BEGIN RSA PRIVATE KEY-----\n" \
	"MIIEowIBAAKCAQEAzFT3qFKGvMFYdq9AWFw1P8MKjMuWPakEn72HFts23wM/agTR\n" \
	"bEErTpECJ0Dhv90ObsbyXSR+aHj2aGgtIRz5X5eWtnY68hslx7orzIFD5yxFeWAY\n" \
	"kEk+6zm2qbvzThztwI/qwxyPvUI8bq4Allx4n3jLSn83TZFPyrk293JZPseyKjKE\n" \
	"BpY1hJNlNpzSbtEoLBH5OkcmI+vtc0cDjNaIG/bsZT9bJWIXlcnHkU+hylmkIUEr\n" \
	"PAFDBb61QDzgg2RvWlgbPGW6LkG6PYClZnKAHh/Bc0oBCpHfG1fFt4ECFRf5FzU0\n" \
	"zMO7Bf9EmPlDSWxics1wv3wA5uZ843H14PGVDwIDAQABAoIBAAqCdkiF53XkRfNj\n" \
	"eTOc7oTh4x7ccSpTvAVRVMDus92i8ks22zoDsha066pEMo2mm5GZZv7hG9ADehJj\n" \
	"BVXg18y8ZHKXFdoSXmOYUPIQVgNDv4EKLx6WEzKQbIjsvgtu/nrl4W/OqMVVwlD5\n" \
	"CdZcrubuP2/h/OC0UCkqVJ2ZQpDcJ2N0xYJELyEVywwpuatAPx9YeHz9PcRCpKnt\n" \
	"d1aMjiDeqtv0dHzMWCru7aDkxieEBQ1q9Fgk85l5EXpyxaw0ZENYf9HqBJlZSUxw\n" \
	"Clsa2FNOPf3GIflixT0r5ZQk1Wbt7CL9qqWf/MiqMwpAjl0SKoKcVaNZde6exmmc\n" \
	"O73wlFECgYEA7bL9mW7zkEIrDNsnaw/fU0VWh9o+AeriiCM6l44nEeaEcqTVGz3+\n" \
	"YDZJpB4vIYYwXSNptisMZtPf0f6nnIi9fcXS0qHMTskMe183nDVu/6ipxhXED3rP\n" \
	"C8rJxO6PwWP0WZ+PYnIXDeZEfC/eOHiAkhGxvFHIRJVnT2lsBxQCrx8CgYEA3BBQ\n" \
	"RakwfpujDb54kXwJyhjs2G+2tVrQZET2l7aLkGCzd7eU3AdgGUvmN6OzmqKmUQvk\n" \
	"G46MTW95oW915AyFD80XxSYMORQux21D3+drdsboS6N8Km5GmCHTPxhgITsBpRgM\n" \
	"Em4eeZvM+0j/p7KKaFaQRmuEed9Y8v6c9j4hjBECgYArZXtRUOVc2Ae+ECDRNhOi\n" \
	"w0z5/olFllmHW08uLkDJztktiRRzJc1USXUGZpBaQYKA7p81KATanSIG18RIGtrl\n" \
	"pIFJ/UostB34RDkF5ud9+5ALXxvta5FzaLGPp7JNL2+EEVJ/Oa8l1X15Ys/iZXWr\n" \
	"tVlKtW+nvdMft3KGlEutJwKBgQDA6zhD6W+O/ofx65GtEM1QM4umrkDBOezIikCX\n" \
	"fbtaBbwvbmv8fCa95nDbRBKWtJITKNZ/ZfcPh3Ncl+cE1gjsckKtXY6Hl27u+5Xu\n" \
	"OuVVykgozxhx5hzTD4wumwLi/uSRQ8SJf6oNuAz6GeOtsvJtR73RTj5jzO4gkB8w\n" \
	"LAWi0QKBgG2W7bLtg/vYNWzc5uYFtZQyrtslnLKr5Zh4hIWRwMMTtzcO/etX6rMR\n" \
	"/Yl3nPTvD1KQ2q9Zjc68tAC4IYutMBdtuaSQfI17TF8iJOclZB5KXnaiZ0kgwO5+\n" \
	"5UR1/BvlLwi6+9hwbZo4oNO2UxZEM1TLQfnFkWDToeHjozRY2mVw\n" \
	"-----END RSA PRIVATE KEY-----\n" \

#define CLIENT_PUBLIC_CERTIFICATE \
    "-----BEGIN CERTIFICATE-----\n" \
	"MIIC0jCCAbqgAwIBAgIQXQ9kV4q0TuKTY0OPLeWyeDANBgkqhkiG9w0BAQsFADAZ\n" \
	"MRcwFQYDVQQDDA5jbG91ZGlvLWRldi1jYTAgFw0yMDA4MzEwNjQ3MjFaGA8yMTIw\n" \
	"MDgzMTA2NDcyMVowLzEtMCsGA1UEAwwkNWQwZjY0NTctOGFiNC00ZWUyLTkzNjMt\n" \
	"NDM4ZjJkZTViMjc4MIIBIjANBgkqhkiG9w0BAQEFAAOCAQ8AMIIBCgKCAQEAzFT3\n" \
	"qFKGvMFYdq9AWFw1P8MKjMuWPakEn72HFts23wM/agTRbEErTpECJ0Dhv90Obsby\n" \
	"XSR+aHj2aGgtIRz5X5eWtnY68hslx7orzIFD5yxFeWAYkEk+6zm2qbvzThztwI/q\n" \
	"wxyPvUI8bq4Allx4n3jLSn83TZFPyrk293JZPseyKjKEBpY1hJNlNpzSbtEoLBH5\n" \
	"OkcmI+vtc0cDjNaIG/bsZT9bJWIXlcnHkU+hylmkIUErPAFDBb61QDzgg2RvWlgb\n" \
	"PGW6LkG6PYClZnKAHh/Bc0oBCpHfG1fFt4ECFRf5FzU0zMO7Bf9EmPlDSWxics1w\n" \
	"v3wA5uZ843H14PGVDwIDAQABMA0GCSqGSIb3DQEBCwUAA4IBAQB9lvVnImhmpCD/\n" \
	"H473AlaVZrN9ttBCutDo60YwB/qJP3ogsYz7jXx1f+q5kZUqMVP9/lnZvTZ0ebQe\n" \
	"95cVsr0Urci9LYu1rcMtm/VKfM+r/OB5U543vJYDf8/GXTxEkXgWB7IcTD5khYy6\n" \
	"WWQSJTObmui03jOFEitOQ+Cb07BGkJN+WO4g1RTbFh4ep8o+9nTHbQbSEe/T89j0\n" \
	"u3Mos1f/XP5ziRMdu3a+xdxl4sQNZhbYO0Mxfs2m7q5woQjcDGVT4uGUXSB4j11D\n" \
	"pJYU9Djq4GCszCOxeelQQlmRy6McHUNAr4bhoZ2cJ4y9A2+hSEnp//polfYmwvlE\n" \
	"bvy0mkpJ\n" \
	"-----END CERTIFICATE-----\n" \

#define ENDPOINT_JSON \
"{"\
	"\"nodes\":{"\
		"\"Kitchen\":{"\
		"\"implements\":["\
			"\"None\""\
		"],"\
		"\"objects\":{"\
			"\"TempMeasurement\":{"\
				"\"conforms\":null,"\
				"\"attributes\":{"\
					"\"KitchenTemp\":{"\
						"\"constraint\":\"Measure\","\
						"\"type\":\"Number\","\
						"\"timestamp\":1601108327,"\
						"\"value\":10.0"\
					"}"\
				"}"\
			"}"\
		"}"\
	"}"\
 "}"\
"}"\

#endif /* _CERTIFICATES_H_ */
```
